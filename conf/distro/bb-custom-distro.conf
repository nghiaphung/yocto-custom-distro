## conf/distro/bb-custom-distro.conf
```bitbake
# Distro Layer configuration
# include and overwrite default poky distro

include conf/distro/poky.conf

UPSTREAM_DISTRO := "${DISTRO}"
UPSTREAM_CODENAME := "${DISTRO_CODENAME}"
UPSTREAM_VERSION := "${DISTRO_VERSION}"
UPSTREAM_NAME := "${DISTRO_NAME}"

DISTRO = "bb-custom-distro"
DISTRO_NAME = "Custom distro for BlackBeagleBone"
DISTRO_VERSION = "1.0"
DISTRO_CODENAME = "bbbdistro"
SDK_VENDOR = "-bb-dustom-distro-sdk"
SDK_VERSION="${DISTRO_VERSION}"
MAINTAINER = "ducnghia318@gmail.com"

TARGET_VENDOR = "-bb-custom-distro"

DISTRO = "bb-custom-distro"
DISTRO_NAME = "Custom distro for BlackBeagleBone"
DISTRO_VERSION = "1.0"
DISTRO_CODENAME = "bbbdistro"
SDK_VENDOR = "-pokysdk"
SDK_VERSION = "${@d.getVar('DISTRO_VERSION').replace('snapshot-${DATE}', 'snapshot')}"

MAINTAINER = "ducnghia318@gmail.com"

TARGET_VENDOR = "-bbbcustom"

LOCALCONF_VERSION = "1"

DISTRO_VERSION[vardepsexclude] = "DATE"
SDK_VERSION[vardepsexclude] = "DATE"
BUILD_VERSION[vardepsexclude] = "DATETIME"

PACKAGE_CLASSES = "package_rpm"

# Use systemd as init manager
#DISTRO_FEATURES:append = " systemd"
#DISTRO_FEATURES_BACKFILL_CONSIDERED += "sysvinit"
#VIRTUAL-RUNTIME:init_manager = "systemd"
#VIRTUAL-RUNTIME:initscripts = "systemd-compat-units"
```
